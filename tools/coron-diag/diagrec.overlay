/*
 * Passed with -DEXTRA_DTC_OVERLAY_FILE to the test builds (boot instrument, diag_boot.c) AND to the
 * production build with CONFIG_CORON_DIAG_ENTRY (boot breadcrumb, diag_entry.c). Carves a 4 KB
 * region out of the top of the application's RAM, so every image places its records at the same
 * address (0x2002c000) regardless of its .bss/.noinit size, and a new image can read what the
 * previous one left. Zephyr's RAM shrinks to 176 KB; an image that needs more fails to link
 * instead of silently moving the records.
 * 0x2002c000 is above the bootloader's static RAM (.data/.bss end at 0x2000ce28) and 80 KB below
 * its stack top (0x20040000); see evidence/bootloader-ram.md.
 */
/ {
	diagrec: memory@2002c000 {
		compatible = "zephyr,memory-region", "mmio-sram";
		reg = <0x2002c000 0x1000>;
		zephyr,memory-region = "DIAGREC";
		status = "okay";
	};
};

&sram0 {
	reg = <0x20000000 0x2c000>;
};
