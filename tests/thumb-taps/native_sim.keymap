#include "../../config/coron.keymap"
#include "../coron_test.h"

&kscan {
    rows = <1>;
    columns = <51>;

    events = <
        /* 無変換を単体でタップ */
        PRESS(POS_MUHENKAN, 50) RELEASE(POS_MUHENKAN, 100)
        /* 変換を単体でタップ */
        PRESS(POS_HENKAN, 50) RELEASE(POS_HENKAN, 100)
        /* 右スペースを単体でタップ */
        PRESS(POS_SPACE_R, 50) RELEASE(POS_SPACE_R, 100)
        /* 左スペースを単体でタップ */
        PRESS(POS_SPACE_L, 50) RELEASE(POS_SPACE_L, 100)
        /* スペースを離す前に次の文字を打つ (ロールオーバー)。コンボに関係しない A で確かめる */
        PRESS(POS_SPACE_R, 30) PRESS(POS_A, 30) RELEASE(POS_SPACE_R, 30) RELEASE(POS_A, 100)
        /* 変換を離す前に次の文字を打つ。コンボに関係しない H で確かめる */
        PRESS(POS_HENKAN, 30) PRESS(POS_H, 30) RELEASE(POS_HENKAN, 30) RELEASE(POS_H, 100)
        /* 無変換を離す前に次の文字を打つ */
        PRESS(POS_MUHENKAN, 30) PRESS(POS_A, 30) RELEASE(POS_MUHENKAN, 30) RELEASE(POS_A, 100)
    >;
};
