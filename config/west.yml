## config/west.yml
```yaml
manifest:
  remotes:
    - name: cormoran
      url-base: https://github.com/cormoran
    - name: zmkfirmware
      url-base: https://github.com/zmkfirmware
    - name: keebJP
      url-base: https://github.com/keebJP
    - name: haoblackj
      url-base: https://github.com/haoblackj
    - name: t-ogura
      url-base: https://github.com/t-ogura
  projects:
    # ZMK: DYA Studio 用カスタム RPC サブシステム付き cormoran fork（main 系列、Zephyr 4.1）
    - name: zmk
      remote: cormoran
      revision: main+dya
      import:
        file: app/west.yml
    # Zephyr: ZMK 本家の版（cormoran 版 ZMK の app/west.yml が指すものと同じ）。
    # cormoran fork（v4.1.0+zmk-fixes+nrf-half-duplex-uart）との差は、Coron が使わない有線分割用の
    # 半二重 UART ドライバと、本家に 2026-08-14 に入った Bluetooth コントローラの修正2件
    # （分割セントラルが固まる件、接続パラメータ更新時にペリフェラルが落ちる件）だけ。
    - name: zephyr
      remote: zmkfirmware
      revision: v4.1.0+zmk-fixes
      clone-depth: 1
      import:
        name-blocklist:
          - ci-tools
          - hal_altera
          - hal_cypress
          - hal_infineon
          - hal_microchip
          - hal_nxp
          - hal_openisa
          - hal_xtensa
          - hal_st
          - hal_ti
          - loramac-node
          - mcuboot
          - mcumgr
          - net-tools
          - openthread
          - edtt
          - trusted-firmware-m
    # DYA Studio モジュール（すべて cormoran リポジトリ）
    - name: zmk-feature-custom-settings
      remote: cormoran
      revision: main
    - name: zmk-module-ble-management
      remote: cormoran
      revision: main
    - name: zmk-module-battery-history
      remote: cormoran
      revision: main
    - name: zmk-module-settings-rpc
      remote: cormoran
      revision: main
    - name: zmk-module-runtime-input-processor
      remote: cormoran
      revision: main
    - name: zmk-feature-runtime-combo
      remote: cormoran
      revision: main
    - name: zmk-feature-runtime-macro
      remote: cormoran
      revision: main
    - name: zmk-pmw3610-driver
      remote: haoblackj
      revision: e0cd6714f3725b682d4fcf193ffddf3c0cf337c9 # feat/zephyr-4.1-compat: fix/polling-rate-125-sw-drop (2936de8) + compatible "pixart,pmw3610-alt" for Zephyr 4.1
    - name: zmk-input-processor-deadzone
      remote: haoblackj
      revision: 7b6578dfafcd43ee4e8a5e20f0e6f978065be43b # fix/deadzone-flush-instead-of-discard: hysteresis filter instead of threshold+timeout gate
  self:
    path: config
```

## tools/coron-diag/Kconfig
```kconfig
config CORON_DIAG_BOOT
	bool "Boot-path test aid: stage markers, entry clock snapshot, HF-timer recovery reset"
	select BOARD_EARLY_INIT_HOOK
	help
	  Test builds only. Records where each boot got to in RAM that survives a soft reset,
	  arms TIMER4 as a recovery net, and adds the 'r' (soft reset) console command.

config CORON_DIAG_BOOT_FIX
	bool "In the early hook, bring the LF/HF clocks to a documented stopped state"
	depends on CORON_DIAG_BOOT
	help
	  Not used: its HFXO wait condition is wrong (it waits for HFCLKSTAT.STATE == 0, but
	  stopping the HFXO only falls back to HFINT, STATE stays running). Kept for the record.

config CORON_DIAG_ENTRY
	bool "Production: clean the boot entry the bootloader's DFU exit leaves behind, and keep a boot breadcrumb"
	depends on !CORON_DIAG_BOOT
	select BOARD_EARLY_INIT_HOOK
	help
	  For the production image. In board_early_init_hook: clear the POWER/CLOCK interrupt
	  enables, every NVIC enable and pending bit, the stale HFCLKSTARTED event and SysTick
	  (stores only, no waits, no clock operations); then keep an 8-word boot breadcrumb at
	  the fixed address 0x2002c000 (diagrec.overlay is required: the build fails without the
	  node) that the next boot prints in the console dump ('ZDIAG crumb ...'). Not together
	  with CORON_DIAG_BOOT (same early hook). See src/diag_entry.c. Re-review if EARLY init,
	  a SoC early hook or SoftDevice/MPSL is ever enabled.

config CORON_DIAG_ENTRY_CRUMB
	bool "Lab: keep the 8-word boot breadcrumb at 0x2002c000 (needs diagrec.overlay)"
	depends on CORON_DIAG_ENTRY
	help
	  Lab images only (leader, 2026-10-09: nothing kept inside the chip across resets in
	  production; records go to the PC). Keeps the breadcrumb that the next boot prints as
	  'ZDIAG crumb ...'. Requires diagrec.overlay (the build fails without the node) and
	  shrinks the application's RAM to 176 KB. The production image leaves this off: the
	  entry clean stays, the overlay goes, the RAM is the full 256 KB.

config CORON_DIAG_LAB
	bool "Lab, once: lateness probe + activity timeline + ISR trace + controller scheduling trace + printk capture + records (3 kept)"
	depends on CORON_DIAG_ENTRY_CRUMB && !CORON_DIAG_LAT
	select BT_CTLR_ASSERT_HANDLER
	select THREAD_NAME
	help
	  Lab image only (2026-10-09, leader: measure once, take everything). See src/diag_lab.c and
	  diag_lab_ctlr.c (the controller's scheduling functions wrapped at link time). Records live
	  in a 44 KB RAM block at 0x2002d000 (above DIAGREC, 32 KB below the bootloader's stack top)
	  that survives a reboot; the console dump prints them ('ZDIAG lab ...'), 'c' clears them,
	  'A' self-tests the assert path, 'M' the late-prepare path. TIMER4 is taken (TIMER3 too when
	  CONFIG_ZERO_LATENCY_IRQS is on: the masked-region sampler). Needs CONFIG_TRACING_USER
	  (+ISR, +THREAD) from the conf (prod-entry-lab.conf).

config CORON_DIAG_LAT
	bool "Lab: interrupt-latency probe (TIMER4, 1 kHz, the LLL's IRQ level) and link-layer assert capture"
	depends on CORON_DIAG_ENTRY_CRUMB
	select BT_CTLR_ASSERT_HANDLER
	select THREAD_NAME
	help
	  Lab image only (2026-10-09). Records every interrupt latency of 100 us or more with
	  the interrupted context (thread frame PC/LR, NVIC active bits, thread name), and, when
	  the controller asserts, file/line and the same context, into 0x2002c800 of the DIAGREC
	  region. The next boot's console dump prints both ('ZDIAG lat ...'). See src/diag_lat.c.
	  TIMER4 is taken (CORON_DIAG_BOOT also uses it; CORON_DIAG_ENTRY excludes that one).

config CORON_DIAG_ENTRY_CLEAN
	bool "In the early hook, right after the net is armed, clear what the bootloader's DFU exit leaves behind"
	depends on CORON_DIAG_BOOT
	help
	  T1 (2026-10-09) measured at the hook after a UF2 write: POWER.INTEN = 0x380 (the USB
	  power-event interrupt enables), the USBD IRQ still enabled in NVIC, EVENTS_HFCLKSTARTED
	  set. None of these is left by a plain reset path. This option clears the POWER/CLOCK
	  interrupt enables, every NVIC enable and pending bit except the net's own TIMER4, the
	  stale HFCLKSTARTED event and SysTick. Stores only, no waits, no clock operations
	  (LFCLKSRC is never touched). The snapshot point 'clean' records the state after it.
```
